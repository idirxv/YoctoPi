## layers/meta-custom/conf/distro/yoctopi.conf
```bitbake
require conf/distro/poky.conf

DISTRO = "yoctopi"
DISTRO_NAME = "YoctoPi Distro"
DISTRO_VERSION = "1.0"

DISTRO_FEATURES = "acl bluetooth ipv4 ipv6 largefile ldconfig multiarch nfs opengl seccomp \
                   systemd usbhost usrmerge vfat virtualization wifi xattr zeroconf"

INIT_MANAGER = "systemd"
VIRTUAL-RUNTIME_init_manager = "systemd"
VIRTUAL-RUNTIME_initscripts = ""
EXTRA_IMAGE_FEATURES = ""

PACKAGE_CLASSES = "package_deb"

LICENSE_FLAGS_ACCEPTED += "synaptics-killswitch"
LICENSE_FLAGS_ACCEPTED += "commercial"

IMAGE_LINGUAS = "en-us"

# Extra rootfs space 16GB
IMAGE_ROOTFS_EXTRA_SPACE = "16777216"
```

## layers/meta-custom/conf/layer.conf
```bitbake
# meta-custom Yocto layer configuration
# Add conf and classes directories to BBPATH
BBPATH .= ":${LAYERDIR}"

# Add all recipes to BBFILES (supports .bb and .bbappend)
BBFILES += "${LAYERDIR}/recipes-*/*/*.bb \
            ${LAYERDIR}/recipes-*/*/*.bbappend"

# Layer collection info
BBFILE_COLLECTIONS += "meta-custom"
BBFILE_PATTERN_meta-custom = "^${LAYERDIR}/"
BBFILE_PRIORITY_meta-custom = "6"

# Layer dependencies (add others as needed)
LAYERDEPENDS_meta-custom = "core"

# Compatible Yocto release series (update as needed)
LAYERSERIES_COMPAT_meta-custom = "scarthgap"

# Best practice: Add comments above each variable for clarity.
```
